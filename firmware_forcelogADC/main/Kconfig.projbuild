## firmware_forcelogADC/main/Kconfig.projbuild
```kconfig
menu "Test Configuration"        

    choice ADC_MODULE
        prompt "ADC MODULE"
        default ADC_MODULE_SIMULATION
        help
            ADC MODULE IN USE

        config ADC_MODULE_SIMULATION
            bool "simulation"
        config ADC_MODULE_HX711A
            bool "hx711-a"
    endchoice
    
endmenu

config ADC_PATH
    string
    default "./adc_modules/simulation" if ADC_MODULE_SIMULATION
    default "./adc_modules/hx711-a" if ADC_MODULE_HX711A
```
